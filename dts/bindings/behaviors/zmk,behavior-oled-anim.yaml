## dts/bindings/behaviors/zmk,behavior-oled-anim.yaml
```yaml
# SPDX-License-Identifier: MIT

description: Cycle the peripheral OLED animation at runtime

compatible: "zmk,behavior-oled-anim"

include: zero_param.yaml
```

## dts/bindings/behaviors/zmk,behavior-wpm-set.yaml
```yaml
# SPDX-License-Identifier: MIT

description: Set the central WPM view by index

compatible: "zmk,behavior-wpm-set"

include: one_param.yaml
```

## dts/bindings/behaviors/zmk,behavior-wpm-view.yaml
```yaml
# SPDX-License-Identifier: MIT

description: Cycle the central WPM view (bongo cat, luna, number...)

compatible: "zmk,behavior-wpm-view"

include: zero_param.yaml
```
